## modules/CircBuffer/Kconfig
```kconfig
config CIRCBUFFER
	bool "Enable the CircularBuffer lib"

module = CIRCBUFFER
module-str = "CircBuffer"
source "subsys/logging/Kconfig.template.log_config"
```

## modules/Cobs/Kconfig
```kconfig
config COBS
	bool "Enable the COBS (Consistent Overhead Byte Stuffing) Library"
	default n
	depends on SWFIFO
	help
		Encoder and decoder for framing serial streams.

module = COBS
module-str = "Cobs"
source "subsys/logging/Kconfig.template.log_config"
```

## modules/FsApi/Kconfig
```kconfig
config FSAPI
	bool "Enable the FsApi lib"
	default n
	depends on FILE_SYSTEM
	depends on FILE_SYSTEM_LITTLEFS
	depends on FILE_SYSTEM_MKFS
	help
	  Handle-based file system API over the Zephyr VFS and littlefs.
	  FsApi_init mounts every enabled zephyr,fstab,littlefs node.
	  FsApi_addMount adds any other mount, for example littlefs on a RAM
	  disk. FILE_SYSTEM_MKFS provides fs_mkfs for FsApi_format.

if FSAPI

config FSAPI_MAX_MOUNTS
	int "Maximum number of mounts"
	default 2
	help
	  Size of the mount table: the fstab nodes plus the FsApi_addMount
	  mounts.

config FSAPI_MAX_OPEN_FILES
	int "Maximum number of open file handles"
	default 4
	help
	  Size of the file handle pool. CONFIG_FS_LITTLEFS_NUM_FILES must be
	  greater than or equal to this value.

config FSAPI_MAX_OPEN_DIRS
	int "Maximum number of open directory handles"
	default 2
	help
	  Size of the directory handle pool. CONFIG_FS_LITTLEFS_NUM_DIRS must
	  be greater than this value, because FsApi_listDir uses one more
	  directory.

endif # FSAPI

config FSAPIRPC
	bool "Enable the FsApiRpc callset"
	depends on FSAPI
	depends on NANOPB
	depends on PBGENERIC
	depends on PROTORPC
	help
	  ProtoRpc callset for remote access to the FsApi file system.

module = FSAPI
module-str = "FsApi"
source "subsys/logging/Kconfig.template.log_config"

module = FSAPIRPC
module-str = "FsApiRpc"
source "subsys/logging/Kconfig.template.log_config"
```

## modules/IniFileParser/Kconfig
```kconfig
config INIFILEPARSER
	bool "Enable the IniFileParser lib"
	default n
	depends on FSAPI
	help
	  Read-only parser for INI-style configuration files on a FsApi mount,
	  for example /flash/etc/config/net.conf.

if INIFILEPARSER

config INIFILEPARSER_MAX_LINE
	int "Longest line, including the NUL"
	default 128
	help
	  Size of the line buffer, which is on the stack of the caller. A
	  longer line makes IniFileParser_get return -E2BIG.

endif # INIFILEPARSER

module = INIFILEPARSER
module-str = "IniFileParser"
source "subsys/logging/Kconfig.template.log_config"
```

## modules/ProtoRpc/Kconfig
```kconfig
config PROTORPC
	bool "Enable the ProtoRpc lib"
	depends on PBGENERIC

config PROTORPC_MAX_MSG_SIZE
	int "Max on-the-wire size for a packed protobuf message."
	default 2048

config PROTORPC_TRACE_MODULE
	bool "Enables Tracing of this module."
	depends on TRACEMODULE

config PROTORPC_TRACE_MODULE_ID
	int "TraceModule ID for this module (see TraceModule.h)."
	default -1
	help
	  Sets the ID for this trace module. Default of -1 will cause a compilation error.
	  Must define a valid value.

config PROTORPC_TRACE_MODULE_LEVEL
	int "TraceModule level for the module (see TraceModule.h)."
	default 3



module = PROTORPC
module-str = "ProtoRpc"
source "subsys/logging/Kconfig.template.log_config"
```

## modules/Publisher/Kconfig
```kconfig
config PUBLISHER
	bool "Enable the Publisher lib"
	default n
	depends on MQTTCLIENT
	depends on PBGENERIC
	help
	  Encapsulates MQTT topic publishing.

config PUBLISHER_MAX_STRING_SIZE
	int "Max size for a Publisher string payload."
	default 128
	depends on PUBLISHER

module = PUBLISHER
module-str = "Publisher"
source "subsys/logging/Kconfig.template.log_config"
```

## modules/RtosUtils/Kconfig
```kconfig
config RTOSUTILS
	bool "Enable the RtosUtils lib."

config RTOSUTILS_RPC
	bool "Enable the RtosUtils rpc lib."
	depends on NANOPB
	depends on PBGENERIC
	depends on PROTORPC

module = RTOSUTILS
module-str = "RtosUtils"
source "subsys/logging/Kconfig.template.log_config"
```

## modules/SerialPipe/Kconfig
```kconfig
config SERIALPIPE
	bool "Enable the SerialPipe lib"
	default n
	select UART_PIPE
	depends on SWFIFO
	help
	  Byte pipe over the chosen zephyr,uart-pipe UART. Owns the uart-pipe
	  receive callback and presents inbound and outbound fifos. Performs no
	  framing - that belongs to the layer above.

config SERIALPIPE_RX_BUF_SIZE
	int "Size of the buffer registered with uart_pipe_register()."
	default 64
	depends on SERIALPIPE

config SERIALPIPE_RX_FIFO_DEPTH
	int "Bytes of receive buffering."
	default 1024
	depends on SERIALPIPE

config SERIALPIPE_TX_ITEM_SIZE
	int "Max bytes accepted by a single SerialPipe_send() call."
	default 256
	depends on SERIALPIPE

config SERIALPIPE_TX_DEPTH
	int "Number of items in the transmit slab."
	default 8
	depends on SERIALPIPE

config SERIALPIPE_TX_STACK_SIZE
	int "Stack size for the SerialPipe transmit thread."
	default 1024
	depends on SERIALPIPE

config SERIALPIPE_TX_THREAD_PRIO
	int "Priority for the SerialPipe transmit thread."
	default 8
	depends on SERIALPIPE

module = SERIALPIPE
module-str = "SerialPipe"
source "subsys/logging/Kconfig.template.log_config"
```

## modules/SwFifo/Kconfig
```kconfig
config SWFIFO
	bool "Enable the SwFifo lib"
	default n

config SWFIFO_LOCKING
	bool "Compile in SwFifo locking"
	default y
	depends on SWFIFO
	help
	  Compiles in spinlock protection for fifos created with the threadsafe
	  flag set. A spinlock is used rather than a mutex so that a fifo shared
	  between an ISR and a thread can be protected; mutexes are illegal in an
	  ISR and cannot block one in any case. Fifos created with threadsafe
	  clear are unaffected and take no lock.

module = SWFIFO
module-str = "SwFifo"
source "subsys/logging/Kconfig.template.log_config"
```

## modules/System/Kconfig
```kconfig
config SYSTEM
	bool "Enable the System lib."

config SYSTEMRPC
	bool "Enable the SystemRpc."
	depends on SYSTEM
	depends on NANOPB
	depends on PBGENERIC
	depends on PROTORPC

module = SYSTEM
module-str = "System"
source "subsys/logging/Kconfig.template.log_config"

module = SYSTEMRPC
module-str = "SystemRpc"
source "subsys/logging/Kconfig.template.log_config"
```

## modules/TcpEcho/Kconfig
```kconfig
config TCPECHO
	bool "Enable the TcpEcho server lib"
	default n
	depends on TCPSERVER
	depends on TCPSOCKET

module = TCPECHO
module-str = "TcpEcho"
source "subsys/logging/Kconfig.template.log_config"
```

## modules/TcpRpcServer/Kconfig
```kconfig
config TCPRPCSERVER
	bool "Enable the TcpRpcServer lib"
	default n
	depends on TCPSERVER
	depends on PROTORPC
	depends on TCPSOCKET
	depends on COBS

config TCPRPCSERVER_PORT
	int "TCP port for the TcpRpcServer"
	default 13001
	depends on TCPRPCSERVER

module = TCPRPCSERVER
module-str = "TcpRpcServer"
source "subsys/logging/Kconfig.template.log_config"
```

## modules/TcpServer/Kconfig
```kconfig
config TCPSERVER
	bool "Enable the TcpServer lib"
	default n
	depends on TCPSOCKET
	depends on RTOSUTILS

module = TCPSERVER
module-str = "TcpServer"
source "subsys/logging/Kconfig.template.log_config"
```

## modules/UdpServer/Kconfig
```kconfig
config UDPSERVER
	bool "Enable the UdpServer lib"
	depends on UDPSOCKET
	depends on RTOSUTILS

module = UDPSERVER
module-str = "UdpServer"
source "subsys/logging/Kconfig.template.log_config"
```

## modules/slip/Kconfig
```kconfig
config SLIP_FRAME
	bool "Enable the SLIP (Serial Line Interface) framing library"
	default n
	depends on SWFIFO
	help
		Encoder and decoder for framing serial streams.

module = SLIP_FRAME
module-str = "slip_frame"
source "subsys/logging/Kconfig.template.log_config"
```

## templates/app/template/Kconfig.jinja
```kconfig
mainmenu "{{ description }}"

menu "App Options"
{% if net_type != 'none' %}
	choice APP_NET_TYPE
		prompt "Network type"
		default APP_NET_TYPE_{{ net_type | upper }}

		config APP_NET_TYPE_WIFI
		bool "wifi network"

		config APP_NET_TYPE_SERIAL
		bool "serial net"

		config APP_NET_TYPE_ETH
		bool "wired ethernet networking"

		config APP_NET_TYPE_USB
		bool "usb (CDC-ECM) networking"
	endchoice

	config APP_USE_STATIC_IP
	    bool "Use a static IP address rather than DHCP."

	config APP_IPV4_ADDR
	    string "Static IPv4 address."
	    default "{{ ipv4_addr | default('192.0.2.1', true) }}"

	config APP_IPV4_MASK
	    string "Static IPv4 netmask."
	    default "{{ ipv4_mask | default('255.255.255.0', true) }}"

	config APP_IPV4_GW
	    string "Static IPv4 gateway."
	    default "{{ ipv4_gw | default('192.0.2.2', true) }}"
{% endif %}
endmenu

source "Kconfig.zephyr"

module = APP
module-str = "app"
source "subsys/logging/Kconfig.template.log_config"
```

## tests/IniFileParser/testcase.yaml
```yaml
tests:
  inifileparser_tests.parse:
    platform_allow:
      - qemu_x86
    tags: inifileparser
```
