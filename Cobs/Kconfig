## Cobs/Kconfig
```kconfig
config COBS
	bool "Enable the COBS (Consistent Overhead Byte Stuffing) Library"
	default n
	help
		Encoder and decoder for framing serial streams.
```

## Kconfig
```kconfig
rsource "Cobs/Kconfig"
rsource "WifiConnect/Kconfig"
rsource "TcpSocket/Kconfig"
rsource "TcpServer/Kconfig"
rsource "TcpEcho/Kconfig"
rsource "NvParms/Kconfig"
rsource "WS2812Led/Kconfig"
```

## NvParms/Kconfig
```kconfig
config NVPARMS
	bool "Enable NvParms module."
	default n
	depends on FLASH
	depends on FLASH_MAP
	depends on NVS
	depends on SETTINGS
	depends on SETTINGS_RUNTIME
	depends on SETTINGS_NVS
	help
		An abstration for getting parameter settings from NVS.

module = NVPARMS
module-str = "NvParms"
source "subsys/logging/Kconfig.template.log_config"
```

## ProtoRpc/Kconfig
```kconfig
config PROTORPC
	bool "Enable the ProtoRpc lib"
	default n
	select PBGENERIC

module = PROTORPC
module-str = "ProtoRpc"
source "subsys/logging/Kconfig.template.log_config"
```

## TcpServer/Kconfig
```kconfig
config TCPSERVER
	bool "Enable the TcpServer lib"
	default n

module = TCPSERVER
module-str = "TcpServer"
source "subsys/logging/Kconfig.template.log_config"
```

## TcpSocket/Kconfig
```kconfig
config TCPSOCKET
	bool "Enable TcpSocket module."
	default n
	depends on NETWORKING
	depends on NET_TCP
	depends on POSIX_API
	depends on POSIX_NETWORKING
	help
		An abstration for socket functionality.

module = TCPSOCKET
module-str = "TcpSocket"
source "subsys/logging/Kconfig.template.log_config"
```

## WS2812Led/Kconfig
```kconfig
config WS2812LED
	bool "Enable WS2812Led module."
	default n
	depends on LED_STRIP
	help
		A module for WS2812 led strip effects.

module = WS2812LED
module-str = "WS2812Led"
source "subsys/logging/Kconfig.template.log_config"
```

## WifiConnect/Kconfig
```kconfig
config WIFICONNECT
	bool "Enable the WifiConnect lib"
	default n
	depends on WIFI
	depends on NETWORKING
	depends on NET_L2_WIFI_MGMT
	depends on NET_L2_ETHERNET
	depends on NET_IPV4
	depends on NET_DHCPV4
	help
		Connect to local wifi network.

module = WIFICONNECT
module-str = "WifiConnect"
source "subsys/logging/Kconfig.template.log_config"
```

## drivers/net/eth_serial/Kconfig
```kconfig
config ETH_SERIAL
	bool "Enables the ethernet serial device based on uart-pipe."
	default n
	help
	  Enable this option to provide ethernet support for the chosen uart.

config ETH_SERIAL_SLIP
	bool "Enable SLIP framing."
	default n
	select SLIP_FRAME
	select SWFIFO
	help
	  Use SLIP for framing.

config ETH_SERIAL_COBS
	bool "Enable COBS framing."
	default n
	select COBS
	select SWFIFO
	help
	  Use Consistent overhead byte stuffing for framing.


module = ETH_SERIAL
module-str = "eth-serial"
source "subsys/logging/Kconfig.template.log_config"
```

## modules/EchoServer/Kconfig
```kconfig
config ECHOSERVER
	bool "Enable the EchoServer lib"

choice ECHOSERVER_TRANSPORT
	bool "Transport for EchoServer"
	default ECHOSERVER_TRANSPORT_UDP

config ECHOSERVER_TRANSPORT_UDP
	bool "Use UDP for the transport"
	depends on UDPSOCKET
	depends on UDPSERVER

config ECHOSERVER_TRANSPORT_TCP
	bool "Use TCP for the transport"
	depends on TCPSOCKET
	depends on TCPSERVER

endchoice

module = ECHOSERVER
module-str = "EchoServer"
source "subsys/logging/Kconfig.template.log_config"
```

## modules/Kconfig
```kconfig
rsource "Cobs/Kconfig"
rsource "WifiConnect/Kconfig"
rsource "UdpSocket/Kconfig"
rsource "UdpServer/Kconfig"
rsource "TcpSocket/Kconfig"
rsource "TcpServer/Kconfig"
rsource "TcpEcho/Kconfig"
rsource "EchoServer/Kconfig"
rsource "NvParms/Kconfig"
rsource "WS2812Led/Kconfig"
rsource "PbGeneric/Kconfig"
rsource "ProtoRpc/Kconfig"
rsource "TestRpc/Kconfig"
rsource "TcpRpcServer/Kconfig"
rsource "Cobs/Kconfig"
rsource "SwFifo/Kconfig"
rsource "Random/Kconfig"
rsource "slip/Kconfig"
rsource "MqttClient/Kconfig"
rsource "SystemRpc/Kconfig"
```

## modules/MqttClient/Kconfig
```kconfig
config MQTTCLIENT
	bool "Enable the MqttClient lib"
	depends on MQTT_LIB

config MQTTCLIENT_SERVER_PORT
	int "Port for the mqtt server."
	default 1883

config MQTTCLIENT_SERVER_ADDR
	string "IP"
	help
	  IP addr for the broker.

config MQTTCLIENT_POLL_TIMEOUT_MS
	int "Timeout, ms for receive polling."
	default 1000

config MQTTCLIENT_PUBLISH_RX_BUFFER_SIZE
	int "Buffer size for reading received publish messages."
	default 256

config MQTTCLIENT_RX_BUFFER_SIZE
	int "Buffer size for rx messages."
	default 256

config MQTTCLIENT_TX_BUFFER_SIZE
	int "Buffer size for rx messages."
	default 256

config MQTTCLIENT_STACK_SIZE
	int "Stack size for the MqttClient thread."
	default 4096

config MQTTCLIENT_THREAD_PRIO
	int "Thread priority for the MqttClient thread."
	default 30

module = MQTTCLIENT
module-str = "MqttClient"
source "subsys/logging/Kconfig.template.log_config"
```

## modules/PbGeneric/Kconfig
```kconfig
config PBGENERIC
	bool "Enable the PbGeneric lib"
	default n
	depends on NANOPB

module = PBGENERIC
module-str = "PbGeneric"
source "subsys/logging/Kconfig.template.log_config"
```

## modules/Random/Kconfig
```kconfig
config RANDOM
	bool "Enable the RANDOM lib"
	default n
	depends on ENTROPY_GENERATOR
```

## modules/SystemRpc/Kconfig
```kconfig
config SYSTEMRPC
	bool "Enable the SystemRpc lib."
	depends on NANOPB
	depends on PBGENERIC
	depends on PROTORPC

module = SYSTEMRPC
module-str = "SystemRpc"
source "subsys/logging/Kconfig.template.log_config"
```

## modules/TestRpc/Kconfig
```kconfig
config TESTRPC
	bool "Enable the TestRpc lib."
	default n
	depends on NANOPB
	depends on PBGENERIC
	depends on PROTORPC

module = TESTRPC
module-str = "TestRpc"
source "subsys/logging/Kconfig.template.log_config"
```

## modules/TraceModule/Kconfig
```kconfig
config TRACEMODULE
	bool "Enable the TraceModule lib"
	depends on TRACERAM

module = TRACEMODULE
module-str = "TraceModule"
source "subsys/logging/Kconfig.template.log_config"
```

## modules/TraceRam/Kconfig
```kconfig
config TRACERAM
	bool "Enable the TraceRam lib"
	depends on CIRCBUFFER
	depends on SWFIFO

config TRACERAM_DEPTH
	int "Depth of the TraceRam circular buffer."
	default 4096

module = TRACERAM
module-str = "TraceRam"
source "subsys/logging/Kconfig.template.log_config"
```

## modules/UdpSocket/Kconfig
```kconfig
config UDPSOCKET
	bool "Enable the UdpSocket lib"

module = UDPSOCKET
module-str = "UdpSocket"
source "subsys/logging/Kconfig.template.log_config"
```

## tests/CircBuffer/testcase.yaml
```yaml
tests:
  circbuffer_tests.test_circbuffer_writes:
    platform_allow:
      - qemu_x86
      - esp32_devkitc_wroom/esp32/procpu
    tags: circbuffer
```

## tests/slip/testcase.yaml
```yaml
tests:
  slip_tests.test_simple_framer:
    platform_allow:
      - qemu_x86
      - esp32_devkitc_wroom/esp32/procpu
    tags: slip
```
